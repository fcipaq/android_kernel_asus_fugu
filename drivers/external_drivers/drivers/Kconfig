## drivers/external_drivers/drivers/Kconfig
```kconfig
source "drivers/external_drivers/drivers/hwmon/Kconfig"
source "drivers/external_drivers/drivers/misc/Kconfig"
source "drivers/external_drivers/drivers/i2c/busses/Kconfig"
source "drivers/external_drivers/drivers/power/Kconfig"
source "drivers/external_drivers/drivers/platform/x86/Kconfig"
source "drivers/external_drivers/drivers/hsu/Kconfig"
source "drivers/external_drivers/drivers/input/Kconfig"
source "drivers/external_drivers/drivers/socwatch/socwatch_driver/Kconfig"
source "drivers/external_drivers/drivers/socwatch/soc_perf_driver/Kconfig"
```

## drivers/external_drivers/drivers/socwatch/soc_perf_driver/Kconfig
```kconfig
config INTEL_SOCWATCH_PERF_DRV
	boolean "Intel SoCWatch Perf driver support"
	depends on X86_INTEL_MID=y
```

## drivers/external_drivers/drivers/socwatch/socwatch_driver/Kconfig
```kconfig
config INTEL_SOCWATCH_DRV
	boolean "Intel SoCWatch driver support"
	depends on X86_INTEL_MID=y
```
